## main/Kconfig.projbuild
```kconfig
menu "Device Scale Configuration"
    config DEVICE_MAX_VALVES
        int "Maximum Number of Valves"
        default 8
        range 1 16
        help
            Defines the allocation capacity for the runtime valve array tracking matrices.

    config DYNAMIC_VALVE_GPIO_LIST
            string "Comma-separated list of Valve GPIOs"
            default "1,14,18,21,22,16,17,5"
            help
                Enter a comma-separated list of GPIO pin numbers for your valves, one per valve,
                in valve order. Only the first DEVICE_MAX_VALVES entries are used.
                Example: "1,14,18,21,22,16,17,5". No spaces allowed.
                FireBeetle 2 ESP32-C6: GPIO 10/11 are not on the header. GPIO 16/17 are UART0,
                so move the console to USB Serial/JTAG when using them. Avoid GPIO 8/9 (boot
                strapping) and 15 (on-board LED).

    config DEVICE_MAX_VALVE_CONFIG
        int "Maximum single valve setups"
        default 4
        help
            The maximum number of setups a valve can handle.

    config DEVICE_LCD_ENABLE
        int "Is LCD available"
        default 0
        range 0 1
        help
            Is LDD available to use

    menu "Main Power ON"
        config DEVICE_MAX_SIMULTANEOUS_OPEN_VALVES
        int "maximum simultaneous valves"
        default 2
        range 2 6
        help
            maximum simultaneous open valves

    endmenu
    menu "Main Battery ON"
        config DEVICE_MAX_ROUND_ROBIN_TIME_MINI
        int "maximum time for round robin time slice in minutes"
        default 10
        range 5 30
        help
            maximum minutes spend for each values in round robin

    endmenu

endmenu

menu "Wifi Configuration"
    config DEVICE_DEFAULT_WPK_PASSWORD
        string "Configuration mode device password"
        default "56784321"
        help
            Set the configuration-mode device password

    config DEVICE_IP_DEFAULT_GATEWAY
        string "Configuration mode gateway"
        default "192.168.3.1"
        help
            Set the configuration-mode device IP & Gateway

    config DEVICE_IP_DEFAULT_MASK
        string "Configuration mode mask"
        default "255.255.255.0"
        help
            Set the configuration-mode device mast

    config DEVICE_DEFAULT_UNIQUE_SSID
        string "If empty use mac_address"
        default ""
        help
            Enable to append something to Irrigate prefix (Max:24).

    config DEVICE_MAX_DEFAULT_UNIQUE_SSID
        int
        default 24
        help
            Internal max length limit for DEVICE_DEFAULT_UNIQUE_SSID (excluding null terminator).

endmenu
```
